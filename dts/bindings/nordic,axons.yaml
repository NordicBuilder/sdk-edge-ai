## dts/bindings/nordic,axons.yaml
```yaml
# Copyright (c) 2022 Nordic Semiconductor ASA
# SPDX-License-Identifier: LicenseRef-Nordic-5-Clause

description: Nordic Axon NPU

compatible: "nordic,axon"

include:
  - "base.yaml"

properties:
    reg:
      required: true

    interrupts:
      required: true
```
